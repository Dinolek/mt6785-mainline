## Documentation/devicetree/bindings/pinctrl/mediatek,mt6785-pinctrl.yaml
```yaml
# SPDX-License-Identifier: (GPL-2.0-only OR BSD-2-Clause)
%YAML 1.2
---
$id: http://devicetree.org/schemas/pinctrl/mediatek,mt6785-pinctrl.yaml#
$schema: http://devicetree.org/meta-schemas/core.yaml#

title: MediaTek MT6785 Pin Controller

maintainers:
  - Dinolek <git@dinolek.me>

description:
  The MediaTek's MT6785 Pin controller is used to control SoC pins.

properties:
  compatible:
    const: mediatek,mt6785-pinctrl

  reg:
    minItems: 9
    maxItems: 9

  reg-names:
    items:
      - const: base
      - const: rm
      - const: br
      - const: bl
      - const: lb
      - const: rt
      - const: lt
      - const: tl
      - const: eint

  gpio-controller: true

  '#gpio-cells':
    description:
      Number of cells in GPIO specifier. Since the generic GPIO binding is used,
      the amount of cells must be specified as 2. See the below mentioned gpio
      binding representation for description of particular cells.
    const: 2

  gpio-ranges:
    maxItems: 1

  gpio-line-names: true

  interrupts:
    description: The interrupt outputs to sysirq.
    maxItems: 1

  interrupt-controller: true

  '#interrupt-cells':
    const: 2

# PIN CONFIGURATION NODES
patternProperties:
  '-pins$':
    type: object
    additionalProperties: false

    patternProperties:
      '^pins':
        type: object
        allOf:
          - $ref: /schemas/pinctrl/pincfg-node.yaml
          - $ref: /schemas/pinctrl/pinmux-node.yaml
        description:
          A pinctrl node should contain at least one subnodes representing the
          pinctrl groups available on the machine. Each subnode will list the
          pins it needs, and how they should be configured, with regard to muxer
          configuration, pullups, drive strength, input enable/disable and input
          schmitt.

        properties:
          pinmux:
            description:
              Integer array, represents gpio pin number and mux setting.
              Supported pin number and mux are defined as macros in
              dt-bindings/pinctrl/mediatek,mt6785-pinfunc.h for this SoC.

          drive-strength:
            enum: [2, 4, 6, 8, 10, 12, 14, 16]

          bias-pull-down:
            oneOf:
              - type: boolean
                description: normal pull down.
              - enum: [100, 101, 102, 103]
                description: PUPD/R1/R0 pull down type. See MTK_PUPD_SET_R1R0_
                  defines in dt-bindings/pinctrl/mt65xx.h.
              - enum: [200, 201, 202, 203]
                description: RSEL pull down type. See MTK_PULL_SET_RSEL_ defines
                  in dt-bindings/pinctrl/mt65xx.h.

          bias-pull-up:
            oneOf:
              - type: boolean
                description: normal pull up.
              - enum: [100, 101, 102, 103]
                description: PUPD/R1/R0 pull up type. See MTK_PUPD_SET_R1R0_
                  defines in dt-bindings/pinctrl/mt65xx.h.
              - enum: [200, 201, 202, 203]
                description: RSEL pull up type. See MTK_PULL_SET_RSEL_ defines
                  in dt-bindings/pinctrl/mt65xx.h.

          bias-disable: true

          output-high: true

          output-low: true

          input-enable: true

          input-disable: true

          input-schmitt-enable: true

          input-schmitt-disable: true

        required:
          - pinmux

        additionalProperties: false

required:
  - compatible
  - reg
  - interrupts
  - interrupt-controller
  - '#interrupt-cells'
  - gpio-controller
  - '#gpio-cells'
  - gpio-ranges

additionalProperties: false

examples:
  - |
    #include <dt-bindings/pinctrl/mediatek,mt6785-pinfunc.h>
    #include <dt-bindings/interrupt-controller/arm-gic.h>

    pio: pinctrl@10005000 {
        compatible = "mediatek,mt6785-pinctrl";
        reg = <0x10005000 0x1000>,
              <0x11c20000 0x1000>,
              <0x11d10000 0x1000>,
              <0x11e20000 0x1000>,
              <0x11e70000 0x1000>,
              <0x11ea0000 0x1000>,
              <0x11f20000 0x1000>,
              <0x11f30000 0x1000>,
              <0x1000b000 0x1000>;
        reg-names = "base", "rm", "br", "bl", "lb", "rt", "lt", "tl", "eint";
        gpio-controller;
        #gpio-cells = <2>;
        gpio-ranges = <&pio 0 0 202>;
        interrupt-controller;
        interrupts = <GIC_SPI 204 IRQ_TYPE_LEVEL_HIGH>;
        #interrupt-cells = <2>;

        i2c0-pins {
            pins-bus {
                pinmux = <PINMUX_GPIO45__FUNC_SCL6>,
                         <PINMUX_GPIO46__FUNC_SDA6>;
                bias-disable;
            };
        };

        i2c1-pins {
            pins-bus {
                pinmux = <PINMUX_GPIO51__FUNC_SCL0>,
                         <PINMUX_GPIO52__FUNC_SDA0>;
                mediatek,pull-up-adv = <3>;
            };
        };
    };
```

## Documentation/devicetree/bindings/ufs/mediatek,ufs.yaml
```yaml
# SPDX-License-Identifier: GPL-2.0-only OR BSD-2-Clause
%YAML 1.2
---
$id: http://devicetree.org/schemas/ufs/mediatek,ufs.yaml#
$schema: http://devicetree.org/meta-schemas/core.yaml#

title: Mediatek Universal Flash Storage (UFS) Controller

maintainers:
  - Peter Wang <peter.wang@mediatek.com>
  - Chaotian Jing <chaotian.jing@mediatek.com>

properties:
  compatible:
    oneOf:
      - const: mediatek,mt8183-ufshci
      - const: mediatek,mt8195-ufshci
      - items:
          - enum:
              - mediatek,mt8192-ufshci
          - const: mediatek,mt8183-ufshci

  clocks:
    minItems: 1
    maxItems: 8

  clock-names:
    minItems: 1
    maxItems: 8

  phys:
    maxItems: 1

  reg:
    maxItems: 1

  vcc-supply: true

  mediatek,ufs-disable-mcq:
    $ref: /schemas/types.yaml#/definitions/flag
    description: The mask to disable MCQ (Multi-Circular Queue) for UFS host.

  mediatek,ufs-boost-crypt:
    description: Enable boost for crypto engine.
    type: boolean

  mediatek,ufs-support-va09:
    description: Enable VA09 power control support.
    type: boolean

  mediatek,ufs-disable-ah8:
    description: Disable auto-hibernation (AH8).
    type: boolean

  mediatek,ufs-broken-vcc:
    description: Indicates that VCC is broken and needs a workaround.
    type: boolean

  mediatek,ufs-pmc-via-fastauto:
    description: Enable power mode change via FASTAUTO mode.
    type: boolean

  mediatek,ufs-tx-skew-fix:
    description: Enable fix for TX skew issue.
    type: boolean

  mediatek,ufs-rtff-mtcmos:
    description: Enable RTFF MTCMOS power control.
    type: boolean

required:
  - compatible
  - clocks
  - clock-names
  - phys
  - reg
  - vcc-supply

unevaluatedProperties: false

allOf:
  - $ref: ufs-common.yaml

  - if:
      properties:
        compatible:
          contains:
            enum:
              - mediatek,mt8195-ufshci
    then:
      properties:
        clocks:
          minItems: 8
        clock-names:
          items:
            - const: ufs
            - const: ufs_aes
            - const: ufs_tick
            - const: unipro_sysclk
            - const: unipro_tick
            - const: unipro_mp_bclk
            - const: ufs_tx_symbol
            - const: ufs_mem_sub
    else:
      properties:
        clocks:
          maxItems: 1
        clock-names:
          items:
            - const: ufs

examples:
  - |
    #include <dt-bindings/clock/mt8183-clk.h>
    #include <dt-bindings/interrupt-controller/arm-gic.h>

    soc {
        #address-cells = <2>;
        #size-cells = <2>;

        ufs@ff3c0000 {
            compatible = "mediatek,mt8183-ufshci";
            reg = <0 0x11270000 0 0x2300>;
            interrupts = <GIC_SPI 104 IRQ_TYPE_LEVEL_LOW>;
            phys = <&ufsphy>;

            clocks = <&infracfg_ao CLK_INFRA_UFS>;
            clock-names = "ufs";
            freq-table-hz = <0 0>;

            vcc-supply = <&mt_pmic_vemc_ldo_reg>;
        };
    };
```
