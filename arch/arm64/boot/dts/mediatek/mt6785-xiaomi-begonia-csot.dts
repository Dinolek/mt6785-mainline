// SPDX-License-Identifier: (GPL-2.0 OR MIT)
/*
 * Copyright (c) 2026 Dinolek <git@dinolek.me>
 */

/dts-v1/;

#include "mt6785-xiaomi-begonia-common.dtsi"

/ {
	model = "Xiaomi Redmi Note 8 Pro (CSOT)";
	compatible = "xiaomi,begonia", "mediatek,mt6785";
};

&panel {
	compatible = "xiaomi,begonia-csot-nt36672a", "novatek,nt36672a";
	status = "okay";
};
